## src/Kconfig
```kconfig
config CUBE_LOG_LEVEL
    int "Log level of the project's modules and apps"
    default 3
    range 0 4
    help
      0: OFF, 1: ERROR, 2: WARNING, 3: INFO, 4: DEBUG

config APP_MAX
    int "Maximum number of apps"
    default 24
    help
      Size of the app list, the background app included.

config GUI_INIT_PRIORITY
    int "GUI Initialization Priority"
    default 91
    range 0 99

config APP_MGR_INIT_PRIORITY
    int "Application Manager Initialization Priority"
    default 92
    range 0 99

config APP_THREAD_STACK_SIZE
    int "Application Thread Stack Size"
    default 8192
    help
      LVGL rendering, the apps and JPEG decoding run on this thread.
      Check the real usage in the SysInfo app before shrinking it.

config APP_STATE_SIZE
    int "Foreground app state size"
    default 28160
    help
      Memory shared by the foreground apps for their state (one app is open at a time).
      Every app checks at build time that its state struct fits. The largest are the apps
      that show JPEGs: the decoder's working memory (jpeg_mem_t, 27 KB) is part of their state.

config APP_THREAD_SHOW_FPS
    bool "Show FPS"
    default n

config APP_THREAD_ANIM_DURATION_MS
    int "Application Thread Animation Duration (ms)"
    default 300
    range 0 5000

config APP_THREAD_MAX_SLEEP_MS
    int "Application Thread Maximum Sleep Time (ms)"
    default 50
    range 1 1000

config FILE_INIT_PRIORITY
    int "File System Initialization Priority"
    default 90
    range 0 99

config INPUT_THREAD_STACK_SIZE
    int "Input Thread Stack Size"
    default 2048
    help
      Reads the IMU every 10 ms. Check the real usage in the SysInfo app before shrinking it.

config INPUT_ROLL_INVERT
    bool "Invert left/right tilt"
    help
      Flip the sign of roll for everything that reads it (highlight, Level, Photos).
      Enable if tilting moves the highlight the wrong way on screen, e.g. after
      changing the display mirroring (mdac in app.overlay) or the IMU mounting.

config INPUT_PITCH_INVERT
    bool "Invert forward/backward tilt"
    help
      Flip the sign of pitch for everything that reads it (Level bubble, back gesture
      is not affected since it uses both directions).

config WLAN_INIT_PRIORITY
    int "Wi-Fi Initialization Priority"
    default 95
    range 0 99
    help
      Must come after FILE_INIT_PRIORITY: the SSID and PSK are read from the SD card.

config NET_JOB_STACK_SIZE
    int "Network Work Queue Stack Size"
    default 4096
    help
      Shared queue for blocking network work (net_job.h): the Wi-Fi connect request
      (reads the SD card config), SNTP, HTTP.

rsource "apps/Kconfig.apps"
```

## src/apps/Kconfig.apps
```kconfig
menuconfig APP_MENU
    bool "Enable App Menu"
    default n
    help
      Enable the application menu module.
```
