## prj.conf
```kconfig
# main() only idles, but every SYS_INIT (LVGL init, SD mount) runs on this stack.
# Measured peak 1344 bytes ("kernel thread stacks"), keep about 2x margin
CONFIG_MAIN_STACK_SIZE=3072
# The system heap is mostly for the Wi-Fi driver. Its default (HEAP_MEM_POOL_ADD_SIZE_ESP_WIFI,
# 51200) assumes 10 static RX buffers, 6 are used here (about 1.6 KB each), and DRAM region 0
# has no room for more. IGNORE_MIN makes this the whole heap instead of the sum of the minimums
CONFIG_HEAP_MEM_POOL_IGNORE_MIN=y
# Measured peak 32.9 KB (during a Wi-Fi scan; 29 KB with connect, HTTP transfers and Cast),
# "kernel heap" in the shell shows it
CONFIG_HEAP_MEM_POOL_SIZE=40960
CONFIG_GPIO=y
CONFIG_SERIAL=y
CONFIG_CONSOLE=y
CONFIG_PRINTK=y
CONFIG_ESP32_USE_UNSUPPORTED_REVISION=y
# -O2: LVGL software rendering and JPEG decoding are CPU bound, flash has plenty of room
CONFIG_SPEED_OPTIMIZATIONS=y

CONFIG_LOG=y
CONFIG_LOG_BUFFER_SIZE=2048
CONFIG_SHELL=y
# Measured 2976 / 3072 with the wlan commands: config.txt access puts the FatFs long file name
# buffer (512 bytes, FS_FATFS_LFN_MODE_STACK) and two config values on this stack
CONFIG_SHELL_STACK_SIZE=4096
# Logs reach the console through the shell, which has its own queue. INFO stays on during
# development (lower the levels for a release build) and the boot burst overflowed the default
CONFIG_SHELL_BACKEND_SERIAL_LOG_MESSAGE_QUEUE_SIZE=2048
CONFIG_SHELL_BACKEND_SERIAL=y

CONFIG_SPI=y
# With DMA, transfers wait on an interrupt instead of busy polling, so other threads keep running
CONFIG_SPI_ESP32_INTERRUPT=y
CONFIG_DISK_ACCESS=y
CONFIG_DISK_DRIVER_SDMMC=y

CONFIG_FILE_SYSTEM=y
CONFIG_FILE_SYSTEM_SHELL=y
CONFIG_FILE_SYSTEM_MKFS=y
# CONFIG_FILE_SYSTEM_SHELL_MOUNT_COMMAND=y

CONFIG_FAT_FILESYSTEM_ELM=y

CONFIG_FS_FATFS_LFN=y
# The app thread, the shell and the Wi-Fi work queue (config.txt) all use the SD card.
# REENTRANT needs the long file name buffer on the stack instead of a shared static one
CONFIG_FS_FATFS_LFN_MODE_STACK=y
CONFIG_FS_FATFS_REENTRANT=y
# Don't format the card automatically when mount fails (e.g. an exFAT card),
# use "fs mkfs" from the shell instead
CONFIG_FS_FATFS_MOUNT_MKFS=n

CONFIG_DISPLAY=y
CONFIG_ST7789V=y
CONFIG_LVGL=y
CONFIG_LV_COLOR_DEPTH_16=y
# No LV_COLOR_16_SWAP: the panel is pixel-format RGB_565X, so LVGL already renders big-endian
# (LV_COLOR_FORMAT_RGB565_SWAPPED). LV_COLOR_16_SWAP would swap the bytes back at flush.
CONFIG_LV_USE_LOG=y
CONFIG_LV_USE_LABEL=y
CONFIG_LV_DRAW_SW_COMPLEX=y
# CONFIG_LV_USE_FS_FATFS=y
CONFIG_LV_FONT_DEFAULT_MONTSERRAT_18=y
# Text is 18 / 28 / 48 px only: smaller is hard to read through the prism. LVGL implies 14, turn it off
CONFIG_LV_FONT_MONTSERRAT_14=n
CONFIG_LV_FONT_MONTSERRAT_28=y
CONFIG_LV_FONT_MONTSERRAT_48=y
# JPEG decoding uses the project copy in src/lib/tjpgd (RGB565 output, fastest mode)

# Menu stays alive under every app, and Files with ~20 rows plus the fade-in (both screens drawn)
# ran 32 KB out of memory. The RAM left over for the unused libc heap covers the increase.
CONFIG_LV_Z_MEM_POOL_SIZE=65536
# Draw buffer as % of the screen, larger means fewer flushes per frame.
# 10 instead of 20 frees 23 KB of DRAM region 0 for Wi-Fi
CONFIG_LV_Z_VDB_SIZE=10
# Must match LV_COLOR_DEPTH, otherwise the draw buffer is allocated twice as large
CONFIG_LV_Z_BITS_PER_PIXEL=16
# Render the next part while the previous one is sent to the display
CONFIG_LV_Z_FLUSH_THREAD=y
CONFIG_LV_Z_DOUBLE_VDB=y
# CONFIG_LV_Z_LVGL_MUTEX=y
CONFIG_LV_Z_USE_FILESYSTEM=y

CONFIG_LED=y
CONFIG_LED_GPIO=y

CONFIG_SENSOR=y
CONFIG_MPU6050=y

CONFIG_LED_STRIP=y
CONFIG_WS2812_STRIP_I2S=y
# The driver logs an error for the START / DRAIN race that led.c retries (see led_set_raw)
CONFIG_LED_STRIP_LOG_LEVEL_OFF=y

# Wi-Fi station, SSID / PSK from /config.txt on the SD card (src/wlan.c)
CONFIG_NETWORKING=y
CONFIG_WIFI=y
CONFIG_NET_L2_ETHERNET=y
CONFIG_NET_IPV4=y
CONFIG_NET_IPV6=n
CONFIG_NET_DHCPV4=y
# RFC 2131 waits a random 1-10 s before the first DISCOVER (against storms after a power cut),
# one gadget does not need that: 2 s brings it online sooner after boot
CONFIG_NET_DHCPV4_INITIAL_DELAY_MAX=2
CONFIG_NET_TCP=y
CONFIG_NET_SOCKETS=y
CONFIG_NET_MGMT=y
CONFIG_NET_MGMT_EVENT=y
CONFIG_NET_MGMT_EVENT_INFO=y
CONFIG_NET_CONNECTION_MANAGER=y
# Host names (NTP server, HTTP APIs); the DNS servers come from DHCP
CONFIG_DNS_RESOLVER=y
# Default 2 s; the first queries right after connecting sometimes timed out (DNS_EAI_CANCELED)
CONFIG_NET_SOCKETS_DNS_TIMEOUT=5000
# Resend the query after 1 s, then 2 s (the default 5 s backoff equals the timeout: one try only)
CONFIG_NET_SOCKETS_DNS_BACKOFF_INTERVAL=1000
# Clock: time from an NTP server (src/net_time.c)
CONFIG_SNTP=y
# No ESP32_WIFI_STA_RECONNECT: src/wlan.c retries every 10 s itself. The driver's own retries
# race with "wlan set" / "wlan disconnect" and connect again after an explicit disconnect
# Fewer buffers than the defaults, DRAM region 0 is full (see HEAP_MEM_POOL_SIZE)
CONFIG_ESP32_WIFI_STATIC_RX_BUFFER_NUM=6
CONFIG_ESP32_WIFI_DYNAMIC_RX_BUFFER_NUM=16
CONFIG_ESP32_WIFI_DYNAMIC_TX_BUFFER_NUM=16
# No modem sleep: it runs from USB anyway, and sleeping between beacons halved Cast's frame
# rate (3.4 -> 6.5 fps at 240x240) and slowed Upload (60 -> 71 KB/s)
CONFIG_ESP32_WIFI_STA_POWER_SAVE_NONE=y
CONFIG_NET_PKT_RX_COUNT=8
CONFIG_NET_PKT_TX_COUNT=8
# A full TCP window (2 x 1460 bytes) takes 12 of these 256 byte buffers. With 16, one more
# packet (broadcasts, ACKs) during a download dropped frames ("Failed to allocate net buffer")
CONFIG_NET_BUF_RX_COUNT=20
CONFIG_NET_BUF_TX_COUNT=12
# The TCP receive window defaults to RX_COUNT * DATA_SIZE / 3, 682 bytes with 16 x 128: the 40 KB
# weather reply took 18 s from a server ~250 ms away. The buffer data is __noinit (DRAM region 1),
# only the buffer headers are in the full region 0, so the buffers grow instead of their number.
# 20 x 256 holds two full segments with room to spare
CONFIG_NET_BUF_DATA_SIZE=256
CONFIG_NET_TCP_MAX_RECV_WINDOW_SIZE=2920
# Upload / Cast: a listening socket and a client, plus one for a connection that waits in
# TIME_WAIT after the server closed it, next to DNS and SNTP
# Measured peaks 736 (TCP work queue) and 800 (net_mgmt events) of the default 2048
CONFIG_NET_TCP_WORKQ_STACK_SIZE=1536
CONFIG_NET_MGMT_EVENT_STACK_SIZE=1536
CONFIG_NET_MAX_CONTEXTS=5
CONFIG_NET_MAX_CONN=5
# A connection the server closed first keeps its slot this long (default 1500 ms). On a LAN
# a short wait is enough, and a few quick "Connection: close" requests no longer use up the slots
CONFIG_NET_TCP_TIME_WAIT_DELAY=250

# Hardware RNG for the Dice app
CONFIG_ENTROPY_GENERATOR=y

# Settings kept across reboots (storage partition in flash)
CONFIG_FLASH=y
CONFIG_FLASH_MAP=y
CONFIG_NVS=y
CONFIG_SETTINGS=y
CONFIG_SETTINGS_NVS=y

####
# CONFIG_SMP=y
# CONFIG_MP_MAX_NUM_CPUS=2

#### Debug: "kernel thread stacks" in the shell shows stack usage
CONFIG_INIT_STACKS=y
CONFIG_THREAD_STACK_INFO=y
CONFIG_THREAD_NAME=y
# Used by the SysInfo app
CONFIG_THREAD_MONITOR=y
CONFIG_SYS_HEAP_RUNTIME_STATS=y

####
# CONFIG_APP_THREAD_SHOW_FPS=y
CONFIG_APP_MENU=y
# The network stack also runs work on the system work queue: measured 784 / 1024 with Wi-Fi
CONFIG_SYSTEM_WORKQUEUE_STACK_SIZE=2048
```

## include/bg_app.h
```c
#pragma once

#include <zephyr/kernel.h>
#include <zephyr/logging/log.h>
#include <lvgl.h>
#include "app_mgr.h"

#define APP_BG_REGISTER(_name, _app_init, _app_run) \
    LOG_MODULE_REGISTER(_name, CONFIG_CUBE_LOG_LEVEL); \
    APP_REGISTER(_name, NULL, _app_init, _app_run, NULL, 0, 0)
```

## include/input.h
```c
#pragma once

// Orientation from the IMU in degrees. Taps are sent as NAV_TAP (see nav.h).
typedef struct {
    float roll;
    float pitch;
} input_angle_t;

// Latest filtered angles (updated every 10 ms), safe from any thread
void input_get(input_angle_t *angle);
```

## include/jpeg.h
```c
#pragma once

#include <stddef.h>
#include <stdint.h>
#include <zephyr/toolchain.h>

/*
 * Decode a baseline JPEG and write it straight to the display, centered.
 * This bypasses LVGL: call jpeg_begin() once LVGL has nothing left to redraw,
 * and invalidate the screen when switching back to LVGL drawing.
 *
 * The module owns no memory: the app that shows JPEGs keeps a jpeg_mem_t in its state
 * (self_t, the memory shared by the foreground apps) and hands it over with jpeg_begin().
 */

#define JPEG_MAX_WIDTH      240
#define JPEG_MCU_HEIGHT     16      // TJpgDec outputs one row of MCUs at a time, 16 high for 4:2:0
#define JPEG_WORKBUF_SIZE   12288   // the huffman tables of JD_FASTDECODE 2 take about 6 KB of it

// Working memory of the decoder, about 27 KB. Nothing in it needs to be initialized
typedef struct {
    uint8_t workbuf[JPEG_WORKBUF_SIZE];
    // Two row buffers taking turns: one is decoded into while the other goes to the display
    uint16_t row_buf[2][JPEG_MAX_WIDTH * JPEG_MCU_HEIGHT];
} __aligned(4) jpeg_mem_t;

// Make LVGL finish drawing now, after this the screen belongs to jpeg_show(), which works in mem
void jpeg_begin(jpeg_mem_t *mem);

// Stop using the memory given to jpeg_begin(). Call it in the app's exit()
void jpeg_end(void);

// Returns 0 on success, -ENOENT if the file does not exist, -EIO on decode errors
int jpeg_show(const char *path);

// Read the next len bytes into buf, or skip them when buf is NULL. Returns the bytes read,
// fewer than len only at the end of the data or on an error
typedef size_t (*jpeg_read_cb_t)(void *ctx, uint8_t *buf, size_t len);

// Same as jpeg_show() with the data coming from read (e.g. a socket), 0 or -EIO
int jpeg_show_stream(jpeg_read_cb_t read, void *ctx);
```

## include/net_time.h
```c
#pragma once

#include <stdbool.h>
#include <stdint.h>
#include <time.h>

/*
 * Wall clock from an NTP server. Syncs once Wi-Fi has an IP address, then every 6 hours.
 * Settings (conf.h): tz, ntp_server
 */

// "Sun" ... "Sat" (tm_wday) and "Jan" ... "Dec" (tm_mon)
extern const char *const net_time_wday_names[7];
extern const char *const net_time_month_names[12];

// Local time. Returns false (tm untouched) until the first sync succeeded
bool net_time_now(struct tm *tm);

// Seconds since 1970 (UTC), -1 until the first sync
int64_t net_time_unix(void);

// The same in milliseconds, for things that move within a second
int64_t net_time_unix_ms(void);

// Read the tz setting again after it changed (it is otherwise read at boot)
void net_time_load_tz(void);

// Is this a UTC offset the tz setting accepts: "+8", "-5", "+5:30"
bool net_time_tz_valid(const char *text);

// Sync now in the background, e.g. after changing ntp_server
void net_time_sync(void);
```

## include/screenshot.h
```c
#pragma once

// Screenshot over the console: the shell command "shot" asks for one, tools/screenshot.py reads it.
// Call from the LVGL thread before lv_timer_handler(): starts a pending screenshot (full redraw).
void screenshot_process(void);
```

## include/sdconf.h
```c
#pragma once

#include <stddef.h>
#include "file.h"

/*
 * /config.txt on the SD card, one "key=value" per line: the file conf.c imports settings from.
 * Only conf.c uses this, everything else reads its settings with conf_get() (conf.h).
 * Spaces around the key and the value are ignored. Blank lines, '#' comments and other keys
 * are kept as they are when a key is changed or removed.
 */
#define SDCONF_PATH FILE_ROOT "/config.txt"

// Whole file limit, the file is read into a fixed buffer
#define SDCONF_MAX_SIZE 1024

// Copy the value of key into buf (NUL terminated). Returns the value length,
// -ENOENT if the key (or the file) is missing, -ENOSPC if buf is too small
int sdconf_get(const char *key, char *buf, size_t len);

// Replace the key's line, or append one if it is missing. value NULL removes the key
int sdconf_set(const char *key, const char *value);
```

## include/wlan.h
```c
#pragma once

#include <stdbool.h>
#include <stdint.h>

/*
 * Wi-Fi station. The SSID and PSK are the settings wifi_ssid / wifi_psk (conf.h).
 * It connects at boot and retries every 10 s after the link drops.
 * Shell: wlan set / status / forget / connect / disconnect / scan
 */

#define WLAN_SSID_LEN 32
#define WLAN_ADDR_LEN 16    // "255.255.255.255" + NUL
#define WLAN_SCAN_MAX 12

typedef struct {
    int state;                      // enum wifi_iface_state, WIFI_STATE_COMPLETED when linked
    bool online;                    // linked and DHCP gave an address
    char ssid[WLAN_SSID_LEN + 1];   // linked network, empty when not linked
    int rssi;                       // dBm
    unsigned int channel;
    int security;                   // enum wifi_security_type
    char ip[WLAN_ADDR_LEN];         // empty without an address
    char netmask[WLAN_ADDR_LEN];
    char gateway[WLAN_ADDR_LEN];
    uint8_t mac[6];
} wlan_info_t;

typedef struct {
    char ssid[WLAN_SSID_LEN + 1];
    int8_t rssi;
    uint8_t channel;
    uint8_t security;               // enum wifi_security_type
} wlan_ap_t;

// (Re)connect with the saved SSID / PSK. Runs in the background, the result is logged
int wlan_connect(void);

// Drop the link, no reconnect until wlan_connect()
int wlan_disconnect(void);

// Connected and DHCP gave an IPv4 address
bool wlan_is_online(void);

// Current link. Quick, fine to call from an app's run() about once a second
int wlan_info(wlan_info_t *info);

// Start a scan in the background, -EBUSY while one is running
int wlan_scan(void);

bool wlan_scan_busy(void);

// Copy the last scan result: one entry per SSID, strongest first, hidden networks left out.
// Returns the number of entries
int wlan_scan_get(wlan_ap_t *out, int max);

// Short name of an enum wifi_security_type, e.g. "WPA2-PSK"
const char *wlan_security_txt(int security);
```

## src/app_mgr.c
```c
#include <zephyr/kernel.h>
#include <zephyr/logging/log.h>
#include "app_list.h"
#include "app_mgr.h"

LOG_MODULE_REGISTER(app_mgr, CONFIG_CUBE_LOG_LEVEL);

#define APP_MGR_QUEUE_LEN 4

typedef struct {
    app_mgr_event_t event;
    const void *data;
} app_mgr_t;

// 佇列：連續送出的事件 (例如換 app 後馬上結束) 會依序處理，不會互相覆蓋
K_MSGQ_DEFINE(app_mgr_q, sizeof(app_mgr_t), APP_MGR_QUEUE_LEN, 4);

static int app_mgr_send(app_mgr_event_t event, const void *data)
{
    app_mgr_t msg = {
        .event = event,
        .data = data,
    };

    int ret = k_msgq_put(&app_mgr_q, &msg, K_NO_WAIT);
    if (ret < 0) {
        LOG_ERR("App manager queue full, event %d dropped", event);
    }
    return ret;
}

int app_mgr_check(app_mgr_event_t *p_event, const void **p_data)
{
    app_mgr_t msg;

    if (p_event == NULL || p_data == NULL) {
        return -EINVAL;
    }

    int ret = k_msgq_get(&app_mgr_q, &msg, K_NO_WAIT);
    if (ret < 0) {
        return ret;
    }

    *p_event = msg.event;
    *p_data = msg.data;
    LOG_DBG("App manager event checked: %d", *p_event);
    return 0;
}

int app_mgr_load_app(int index)
{
    const app_t *app = app_list_get(index);
    if (app == NULL) {
        LOG_ERR("Application with index %d not found", index);
        return -ENOENT;
    }

    int ret = app_mgr_send(APP_MGR_EVENT_APP_LOAD, app);
    if (ret == 0) {
        LOG_DBG("Loaded application: %s", app->name);
    }
    return ret;
}

int app_mgr_end_app(void)
{
    int ret = app_mgr_send(APP_MGR_EVENT_APP_END, NULL);
    if (ret == 0) {
        LOG_DBG("Ended foreground application");
    }
    return ret;
}

static int app_mgr_init(void)
{
    int ret = app_mgr_load_app(0);
    if (ret < 0) {
        LOG_ERR("Failed to load initial application");
        return ret;
    }

    LOG_INF("Application Manager Initialized");
    return 0;
}

SYS_INIT(app_mgr_init, APPLICATION, CONFIG_APP_MGR_INIT_PRIORITY);
```

## src/app_thread.c
```c
#include <zephyr/kernel.h>
#include <zephyr/logging/log.h>
#include "app_mgr.h"
#include "nav.h"
#include "gui.h"
#include "screenshot.h"
#include <lvgl.h>
#include <string.h>

LOG_MODULE_REGISTER(app_thread, CONFIG_CUBE_LOG_LEVEL);

static void app_thread_entry(void *arg1, void *arg2, void *arg3);

// 前景 app 共用的 state（見 app.h）。noinit：開機不清，每次打開 app 前才清
uint8_t app_state_mem[CONFIG_APP_STATE_SIZE] __noinit __aligned(8);

K_THREAD_DEFINE(
    app_thread,
    CONFIG_APP_THREAD_STACK_SIZE,
    app_thread_entry,
    NULL, NULL, NULL,
    7,
    0,
    0
);

#if IS_ENABLED(CONFIG_APP_THREAD_SHOW_FPS)
static int _draw_fps(uint32_t sleep_ms)
{
    static lv_obj_t *label = NULL;
    if (!label) {
        lv_obj_t *scr = lv_layer_sys();
        label = lv_label_create(scr);
        lv_obj_set_style_text_color(label, lv_color_hex(0xff00ff), LV_PART_MAIN);
    }
    int frame_rate = 1000 / (sleep_ms ? sleep_ms : 1);
    char fps[5] = {0};
    snprintf(fps, sizeof(fps), "%d", frame_rate);
    lv_label_set_text(label, fps);
    return 0;
}
#endif

#define APP_THREAD_MIN_SLEEP_MS 5

// 背景與前景各用一個 group，避免 highlight 到另一個畫面上的物件
static void use_group(lv_group_t *g)
{
    lv_group_set_default(g);
}

static void app_exit(const app_t *app, lv_obj_t *scr)
{
    LOG_INF("Ending foreground application: %s", app->name);
    if (app->exit != NULL) {
        app->exit(scr);
    }
    nav_set_handler(NULL);
    // 先清空 group 再刪物件：否則刪到被 focus 的物件時，LVGL 會把 focus 移到下一個，
    // 觸發 app 的 FOCUSED callback 去存取已經刪掉的物件
    lv_group_remove_all_objs(lv_group_get_default());
    lv_obj_clean(scr);
}

static void app_thread_entry(void *arg1, void *arg2, void *arg3)
{
    int ret;
    uint32_t sleep_ms = 0;
    const app_t *fg_app = NULL;
    const app_t *bg_app = NULL;
    lv_obj_t *fg_scr = lv_obj_create(NULL);
    lv_obj_t *bg_scr = lv_obj_create(NULL);
    lv_group_t *fg_group = lv_group_create();
    lv_group_t *bg_group = lv_group_create();
    app_mgr_event_t event;
    const void *data;

    gui_start();
    do {
        ret = app_mgr_check(&event, &data);
        k_sleep(K_MSEC(100));
    }
    while (ret != 0);

    if (event != APP_MGR_EVENT_APP_LOAD || data == NULL) {
        LOG_ERR("No initial application to load, Exiting app thread");
        return;
    }

    bg_app = (app_t *)data;
    if (bg_app == NULL) {
        LOG_ERR("No background application set, Exiting app thread");
        return;
    }

    lv_screen_load_anim(bg_scr, LV_SCR_LOAD_ANIM_FADE_IN, CONFIG_APP_THREAD_ANIM_DURATION_MS, 0, true);
    use_group(bg_group);
    bg_app->init(bg_scr);
    LOG_INF("Starting background application: %s", bg_app->name);
    while (1) {
        if (fg_app == NULL) {
            bg_app->run(bg_scr);
        }
        else {
            fg_app->run(fg_scr);
        }

        // UART 指令和敲擊都從這裡進來，在 LVGL thread 裡套用
        nav_process(fg_app != NULL);

        ret = app_mgr_check(&event, &data);
        if (ret == 0) {
            switch (event) {
                case APP_MGR_EVENT_NONE:
                    break;
                case APP_MGR_EVENT_APP_LOAD:
                    if (fg_app != NULL) {
                        app_exit(fg_app, fg_scr);
                    }
                    fg_app = (app_t *)data;
                    LOG_INF("Starting foreground application: %s", fg_app->name);
                    use_group(fg_group);
                    memset(app_state_mem, 0, fg_app->state_size);
                    fg_app->init(fg_scr);
                    lv_screen_load_anim(fg_scr, LV_SCR_LOAD_ANIM_FADE_IN, CONFIG_APP_THREAD_ANIM_DURATION_MS, 0, false);
                    break;
                case APP_MGR_EVENT_APP_END:
                    if (fg_app == NULL) {
                        LOG_WRN("No foreground application to end");
                        break;
                    }
                    app_exit(fg_app, fg_scr);
                    fg_app = NULL;
                    use_group(bg_group);
                    lv_screen_load_anim(bg_scr, LV_SCR_LOAD_ANIM_FADE_OUT, CONFIG_APP_THREAD_ANIM_DURATION_MS, 0, false);
                    break;
                default:
                    LOG_ERR("Unknown app manager event: %d, Exiting app thread", event);
                    return;
            }
        }

    #if IS_ENABLED(CONFIG_APP_THREAD_SHOW_FPS)
        _draw_fps(sleep_ms);
    #endif
        screenshot_process();
        sleep_ms = lv_timer_handler();
        if (sleep_ms == LV_NO_TIMER_READY) {
            sleep_ms = CONFIG_APP_THREAD_MAX_SLEEP_MS;
        }
        // 畫不完時 lv_timer_handler 會回傳 0，至少睡一下，優先權較低的 shell 等 thread 才跑得到
        k_msleep(MAX(sleep_ms, APP_THREAD_MIN_SLEEP_MS));
    }
}
```

## src/file.c
```c
#include <zephyr/kernel.h>
#include <zephyr/fs/fs.h>
#include <zephyr/logging/log.h>
#include <ff.h>
#include "file.h"

LOG_MODULE_REGISTER(file, CONFIG_CUBE_LOG_LEVEL);

static FATFS sd_fatfs;
static struct fs_mount_t sd_mnt = {
    .type = FS_FATFS,
    .mnt_point = FILE_ROOT,
    .fs_data = &sd_fatfs,
    .storage_dev = (void *)"SD",
};

bool file_exists(const char *path)
{
    // app thread、shell 和 net_wq 都會呼叫，不能共用 static（帶著 256 bytes 的檔名）
    struct fs_dirent entry;
    return fs_stat(path, &entry) == 0;
}

static int file_init(void)
{
    int rc;

    rc = fs_mount(&sd_mnt);
    if (rc < 0) {
        LOG_ERR("Failed to mount SD card (%d)", rc);
        return rc;
    }

    LOG_INF("SD card mounted at %s", sd_mnt.mnt_point);
    return 0;
}

SYS_INIT(file_init, APPLICATION, CONFIG_FILE_INIT_PRIORITY);
```

## src/gui.c
```c
#include <zephyr/drivers/led.h>
#include <zephyr/drivers/display.h>
#include <zephyr/kernel.h>
#include <zephyr/device.h>
#include <zephyr/logging/log.h>
#include <lvgl.h>
#include "gui.h"
#include "theme.h"

LOG_MODULE_REGISTER(gui, CONFIG_CUBE_LOG_LEVEL);

static const struct device *display_dev = DEVICE_DT_GET(DT_CHOSEN(zephyr_display));

static void gui_clear_screen(void)
{
    lv_obj_t *scr = lv_screen_active();
    lv_obj_set_style_bg_color(scr, lv_color_hex(THEME_BLACK), LV_PART_MAIN);
    lv_obj_set_style_bg_opa(scr, LV_OPA_COVER, LV_PART_MAIN);
}

// 不能在 SYS_INIT 裡畫：LVGL flush thread 要等所有 SYS_INIT 跑完才會啟動，
// 在那之前畫面送不出去，LVGL 會一直等它而卡死開機
void gui_start(void)
{
    lv_refr_now(NULL);

    int ret = display_blanking_off(display_dev);
    if (ret != 0) {
        LOG_ERR("Failed to turn on display (%d)", ret);
    }
}

static int gui_backlight_init(void)
{
    const struct device *led_dev;

    led_dev = DEVICE_DT_GET(DT_PATH(leds));
    if (!device_is_ready(led_dev)) {
        LOG_ERR("LED device not ready");
        return -1;
    }

    int ret;
    ret = led_on(led_dev, 0);
    if (ret != 0) {
        LOG_ERR("Failed to turn on led 0");
        return ret;
    }

    return 0;
}

static int gui_init(void)
{
    if (!device_is_ready(display_dev)) {
        LOG_ERR("Device not ready");
        return 0;
    }

    int ret;

    ret = gui_backlight_init();
    if (ret != 0) {
        LOG_ERR("Failed to initialize backlight");
        return ret;
    }

    // 只設定背景，第一次繪圖和開啟螢幕由 app_thread 呼叫 gui_start()
    gui_clear_screen();

    LOG_INF("GUI initialized");
    return 0;
}

SYS_INIT(gui_init, APPLICATION, CONFIG_GUI_INIT_PRIORITY);
```

## src/prefs.c
```c
#include <zephyr/kernel.h>
#include <zephyr/logging/log.h>
#include <zephyr/settings/settings.h>
#include <stdio.h>
#include "prefs.h"

LOG_MODULE_REGISTER(prefs, CONFIG_CUBE_LOG_LEVEL);

#define PREFS_ROOT "cube"

typedef struct {
    void *buf;
    size_t len;
    int ret;
} prefs_read_t;

static int prefs_ready(void)
{
    static int init_ret = 1;

    if (init_ret == 1) {
        init_ret = settings_subsys_init();
        if (init_ret < 0) {
            LOG_ERR("Settings init failed (%d)", init_ret);
        }
    }
    return init_ret;
}

static int read_cb(const char *key, size_t len, settings_read_cb read_fn, void *cb_arg, void *param)
{
    prefs_read_t *r = param;

    // 只要剛好是這個 key 本身，不要底下的子 key
    if (key != NULL) {
        return 0;
    }
    r->ret = read_fn(cb_arg, r->buf, MIN(len, r->len));
    return 1;
}

int prefs_load(const char *key, void *buf, size_t len)
{
    char name[SETTINGS_MAX_NAME_LEN + 1];
    prefs_read_t r = {
        .buf = buf,
        .len = len,
        .ret = -ENOENT,
    };

    if (prefs_ready() < 0) {
        return -EIO;
    }
    snprintf(name, sizeof(name), PREFS_ROOT "/%s", key);
    int ret = settings_load_subtree_direct(name, read_cb, &r);
    return ret < 0 ? ret : r.ret;
}

int prefs_save(const char *key, const void *buf, size_t len)
{
    char name[SETTINGS_MAX_NAME_LEN + 1];

    if (prefs_ready() < 0) {
        return -EIO;
    }
    snprintf(name, sizeof(name), PREFS_ROOT "/%s", key);
    int ret = settings_save_one(name, buf, len);
    if (ret < 0) {
        LOG_ERR("Failed to save %s (%d)", name, ret);
    }
    return ret;
}
```
